## components/weather/Kconfig.projbuild
```kconfig
menu "Weather Configuration"
    config WEATHER_ENABLE
        bool "Weather Component"
        default y
        help
            Unified weather data component.
            Combines current weather, forecasts, and astronomical data in a single module.

    if WEATHER_ENABLE
        config WEATHER_LATITUDE
            string "Latitude"
            default "40.7128"
            depends on WEATHER_ENABLE
            help
                Latitude for weather data (e.g., 40.7128 for Dhaka).

        config WEATHER_LONGITUDE
            string "Longitude"
            default "-74.0060"
            depends on WEATHER_ENABLE
            help
                Longitude for weather data (e.g., -74.0060 for Dhaka).

        config WEATHER_TIMEZONE
            string "Timezone"
            default "Asia/Dhaka"
            depends on WEATHER_ENABLE
            help
                Timezone for weather data (e.g., "Asia/Dhaka", "Europe/London", or "auto").

        config ASTRONOMICAL_API_KEY
            string "Astronomical API Key"
            default "API_KEY_HERE"
            depends on WEATHER_ENABLE
            help
                API key for Visual Crossing astronomical data.
                Leave empty to disable astronomical features.

        config ASTRONOMICAL_CITY
            string "City for Astronomical Data"
            default "Dhaka,BD"
            depends on WEATHER_ENABLE && ASTRONOMICAL_API_KEY != ""
            help
                City name for astronomical data (e.g., "Dhaka", "London", "Tokyo").

        config ASTRONOMICAL_TIMEZONE
            string "Timezone for Astronomical Data"
            default "Asia/Dhaka"
            depends on WEATHER_ENABLE && ASTRONOMICAL_API_KEY != ""
            help
                Timezone for astronomical data (e.g., "Asia/Dhaka").

        config WEATHER_TASK_STACK_SIZE
            int "Weather task stack size"
            default 8192
            range 1024 32768
            depends on WEATHER_ENABLE
            help
                Stack size for the weather task in bytes.

        config WEATHER_TASK_PRIORITY
            int "Weather task priority"
            default 3
            range 0 25
            depends on WEATHER_ENABLE
            help
                Task priority (0-25). Higher numbers = higher priority.
                Typically WiFi/time tasks run at priority 5-6.

        choice WEATHER_TASK_CORE
            prompt "Task core affinity"
            default WEATHER_TASK_CORE_AUTO
            depends on WEATHER_ENABLE
            help
                Select which core the weather task runs on.

            config WEATHER_TASK_CORE_0
                bool "Core 0"
            config WEATHER_TASK_CORE_1
                bool "Core 1"
            config WEATHER_TASK_CORE_AUTO
                bool "Auto (tSMP only)"
        endchoice

        config WEATHER_TASK_CORE_ID
            int
            default 0 if WEATHER_TASK_CORE_0
            default 1 if WEATHER_TASK_CORE_1
            default -1 if WEATHER_TASK_CORE_AUTO

        menu "Update Intervals"
            depends on WEATHER_ENABLE

            config WEATHER_UPDATE_INTERVAL
                int "Weather Update Interval (minutes)"
                default 15
                range 1 60
                help
                    How often to update current weather data (in minutes).

            config FORECAST_UPDATE_TIME
                string "Forecast daily update time (HH:MM)"
                default "00:03"
                help
                    Update forecast data at this time daily (24-hour format).

            config ASTRONOMICAL_UPDATE_TIME
                string "Astronomical daily update time (HH:MM)"
                default "00:02"
                help
                    Update astronomical data at this time daily (24-hour format).
        endmenu

    endif # WEATHER

endmenu
```

## components/wifi_clock/Kconfig.projbuild
```kconfig
menu "WiFi Clock Configuration"

    menu "WiFi Configuration"
        config WIFI_CLOCK_SSID
            string "WiFi SSID"
            default "myssid"
            help
                Default SSID to connect to.

        config WIFI_CLOCK_PASSWORD
            string "WiFi Password"
            default "mypassword"
            help
                Default WiFi password.

        config WIFI_CLOCK_HOSTNAME
            string "Hostname"
            default "cyd-clock"
            help
                Hostname to set for the device.

        config WIFI_CLOCK_AUTO_CONNECT
            bool "Auto-reconnect on disconnect"
            default y
            help
                Automatically reconnect to WiFi when disconnected.

        config WIFI_CLOCK_POWER_SAVE_MODE
            int "Power save mode"
            default 1
            range 0 2
            help
                WiFi power save mode: 0=WIFI_PS_NONE, 1=WIFI_PS_MIN_MODEM, 2=WIFI_PS_MAX_MODEM.
    endmenu

    menu "Time Configuration"
        config WIFI_CLOCK_TIMEZONE
            string "Timezone"
            default "Asia/Dhaka"
            help
                Timezone string (e.g., "UTC-6", "GMT+6", "Asia/Dhaka").

        config WIFI_CLOCK_FORMAT_24H
            bool "Use 24-hour format"
            default y
            help
                Use 24-hour time format. If disabled, 12-hour format with AM/PM is used.

        config WIFI_CLOCK_NTP_SERVER
            string "NTP Server 1"
            default "pool.ntp.org"
            help
                Primary NTP server.

        config WIFI_CLOCK_NTP_SERVER_2
            string "NTP Server 2"
            default "time.nist.gov"
            help
                Secondary NTP server.

        config WIFI_CLOCK_NTP_SERVER_3
            string "NTP Server 3"
            default "time.google.com"
            help
                Tertiary NTP server.

        config WIFI_CLOCK_SYNC_RETRY_COUNT
            int "NTP sync retry count"
            default 3
            range 1 10
            help
                Number of NTP sync retries.

        config WIFI_CLOCK_SYNC_TIMEOUT_MS
            int "NTP sync timeout (ms)"
            default 5000
            range 1000 30000
            help
                Timeout for NTP synchronization.

        config WIFI_CLOCK_SYNC_RETRY_INTERVAL_MS
            int "NTP sync retry interval (ms)"
            default 2000
            range 1000 30000
            help
                Interval between NTP sync retries.

        config WIFI_CLOCK_ENABLE_DAILY_SYNC
            bool "Enable daily time sync"
            default y
            help
                Synchronize time with NTP server daily.

        config WIFI_CLOCK_DAILY_SYNC_HOUR
            int "Daily sync hour"
            default 3
            range 0 23
            depends on WIFI_CLOCK_ENABLE_DAILY_SYNC
            help
                Hour of day for daily sync (0-23).

        config WIFI_CLOCK_DAILY_SYNC_MINUTE
            int "Daily sync minute"
            default 0
            range 0 59
            depends on WIFI_CLOCK_ENABLE_DAILY_SYNC
            help
                Minute of hour for daily sync (0-59).
    endmenu

    menu "Provisioning Configuration"
        config WIFI_CLOCK_ENABLE_PROVISIONING
            bool "Enable WiFi provisioning"
            default y
            help
                Enable WiFi provisioning functionality.

        config WIFI_CLOCK_PROV_SOFT_AP_SSID
            string "SoftAP SSID"
            default "WIFI_CLOCK_PROV"
            depends on WIFI_CLOCK_ENABLE_PROVISIONING
            help
                SSID for SoftAP provisioning mode.

        config WIFI_CLOCK_PROV_SOFT_AP_PASSWORD
            string "SoftAP Password"
            default ""
            depends on WIFI_CLOCK_ENABLE_PROVISIONING
            help
                Password for SoftAP provisioning mode (empty for open).

        config WIFI_CLOCK_PROV_SOFT_AP_MAX_RETRIES
            int "SoftAP provisioning max retries"
            default 3
            range 1 10
            depends on WIFI_CLOCK_ENABLE_PROVISIONING
            help
                Maximum retry attempts for SoftAP provisioning.

        config WIFI_CLOCK_PROV_SOFT_AP_TIMEOUT_MS
            int "SoftAP provisioning timeout (ms)"
            default 30000
            range 30000 1800000
            depends on WIFI_CLOCK_ENABLE_PROVISIONING
            help
                Timeout for SoftAP provisioning in milliseconds.
    endmenu

    menu "Task Configuration"
        config WIFI_CLOCK_TASK_STACK_SIZE
            int "Task stack size"
            default 4096
            range 2048 16384
            help
                Stack size for WiFi Clock task.

        config WIFI_CLOCK_TASK_PRIORITY
            int "Task priority"
            default 5
            range 1 25
            help
                Priority for WiFi Clock task.

        config WIFI_CLOCK_TASK_CORE_ID
            int "Task core ID"
            default 0
            range 0 1
            help
                Core ID to run WiFi Clock task on.

        config WIFI_CLOCK_TIME_UPDATE_INTERVAL_MS
            int "Time update interval (ms)"
            default 1000
            range 100 60000
            help
                Interval for updating time display.

        config WIFI_CLOCK_EVENT_QUEUE_SIZE
            int "Event queue size"
            default 10
            range 5 50
            help
                Size of internal event queue.
    endmenu

    menu "Advanced Configuration"
        config WIFI_CLOCK_ENABLE_LOGGING
            bool "Enable logging"
            default y
            help
                Enable component logging.

        config WIFI_CLOCK_ENABLE_DEBUG
            bool "Enable debug logging"
            default n
            depends on WIFI_CLOCK_ENABLE_LOGGING
            help
                Enable verbose debug logging.

        config WIFI_CLOCK_ENABLE_MANUAL_SYNC
            bool "Enable manual time sync"
            default y
            help
                Allow manual time synchronization.

        config WIFI_CLOCK_ENABLE_CALLBACKS
            bool "Enable event callbacks"
            default y
            help
                Enable user event callbacks.

        config WIFI_CLOCK_MUTEX_TIMEOUT_MS
            int "Mutex timeout (ms)"
            default 1000
            range 100 5000
            help
                Timeout for mutex acquisition.
    endmenu

endmenu
```

## sdkconfig.defaults
```kconfig
# ESP-IDF SDK Configuration Defaults
# Critical settings for ESP32 Weather Clock Project

# Target and Build Configuration
CONFIG_IDF_TARGET_ESP32=y

# Serial Flasher Config
CONFIG_ESPTOOLPY_FLASHMODE_DIO=y
CONFIG_ESPTOOLPY_FLASHFREQ_40M=y
CONFIG_ESPTOOLPY_FLASHSIZE_4MB=y

# Partition Table
CONFIG_PARTITION_TABLE_CUSTOM=y
CONFIG_PARTITION_TABLE_CUSTOM_FILENAME="partitions.csv"
CONFIG_PARTITION_TABLE_OFFSET=0x8000

# Core System Settings
CONFIG_ESP_DEFAULT_CPU_FREQ_MHZ_160=y
CONFIG_ESP_CONSOLE_UART_BAUDRATE=115200
CONFIG_ESP_CONSOLE_UART_NUM=0
CONFIG_ESP_TASK_WDT_TIMEOUT_S=5
CONFIG_ESP_TASK_WDT_INIT=y

# Wi-Fi Configuration
CONFIG_ESP_WIFI_ENABLED=y
CONFIG_ESP_WIFI_STATIC_RX_BUFFER_NUM=10
CONFIG_ESP_WIFI_DYNAMIC_RX_BUFFER_NUM=32
CONFIG_ESP_WIFI_DYNAMIC_TX_BUFFER=y
CONFIG_ESP_WIFI_TX_BUFFER_TYPE=1
CONFIG_ESP_WIFI_DYNAMIC_TX_BUFFER_NUM=32
CONFIG_ESP_WIFI_IRAM_OPT=y
CONFIG_ESP_WIFI_RX_IRAM_OPT=y

# Wi-Fi Power Save
CONFIG_WIFI_CLOCK_POWER_SAVE_MODE=1

# Logging
CONFIG_LOG_DEFAULT_LEVEL_INFO=y
CONFIG_LOG_DEFAULT_LEVEL=3
CONFIG_LOG_MAXIMUM_EQUALS_DEFAULT=y

# Compiler Optimization
CONFIG_COMPILER_OPTIMIZATION_SIZE=y
CONFIG_COMPILER_OPTIMIZATION_ASSERTIONS_ENABLE=y

# NVS Configuration
CONFIG_NVS_ENCRYPTION=y

# SPI Flash
CONFIG_SPI_FLASH_YIELD_DURING_ERASE=y
CONFIG_SPI_FLASH_WRITE_CHUNK_SIZE=8192

# Ethernet (if needed)
CONFIG_ETH_ENABLED=y
CONFIG_ETH_USE_ESP32_EMAC=y
CONFIG_ETH_PHY_INTERFACE_RMII=y

# MbedTLS Configuration
CONFIG_MBEDTLS_DYNAMIC_BUFFER=y
CONFIG_MBEDTLS_HARDWARE_AES=y
CONFIG_MBEDTLS_HARDWARE_MPI=y
CONFIG_MBEDTLS_HARDWARE_SHA=y

# FreeRTOS
CONFIG_FREERTOS_HZ=100
CONFIG_FREERTOS_CHECK_STACKOVERFLOW_CANARY=y
CONFIG_FREERTOS_IN_IRAM=y
CONFIG_FREERTOS_ENABLE_TASK_SNAPSHOT=y
```
